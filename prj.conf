## CMakeLists.txt
```
#
# Copyright (c) 2018 Nordic Semiconductor
#
# SPDX-License-Identifier: LicenseRef-Nordic-5-Clause
#
cmake_minimum_required(VERSION 3.20.5)

find_package(Zephyr REQUIRED HINTS $ENV{ZEPHYR_BASE})
project(nebula_sensor)

# --- START: Manually add NUS service source ---
# This forces the build system to compile and link the NUS implementation,
# resolving the "undefined reference" error.
# target_sources(app PRIVATE
#     ${ZEPHYR_BASE}/subsys/bluetooth/services/nus/nus.c
# )
# --- END: Manually add NUS service source ---

target_sources(app PRIVATE
  src/main.c
  src/sensor_logic.c
  src/aes_gcm.c
  )
```

## prj.conf
```kconfig
#
# Copyright (c) 2018 Nordic Semiconductor
#
# SPDX-License-Identifier: LicenseRef-Nordic-5-Clause
#

# Enable the UART driver
CONFIG_UART_ASYNC_API=y
CONFIG_NRFX_UARTE0=y
CONFIG_SERIAL=y

CONFIG_GPIO=y

# Make sure printk is printing to the UART console
CONFIG_CONSOLE=y
CONFIG_UART_CONSOLE=y

CONFIG_HEAP_MEM_POOL_SIZE=2048

CONFIG_BT=y
CONFIG_BT_PERIPHERAL=y
CONFIG_BT_DEVICE_NAME="SENSOR_LAB11"
CONFIG_BT_MAX_CONN=1
CONFIG_BT_MAX_PAIRED=1

# Enable the NUS service using the correct symbol for this SDK version
CONFIG_BT_ZEPHYR_NUS=y

# Add this line to enable the default NUS service instance
# CONFIG_BT_ZEPHYR_NUS_DEFAULT_INSTANCE=y

# Add this line to enable dynamic GATT services, which NUS depends on
CONFIG_BT_GATT_DYNAMIC_DB=y

# Enable bonding
CONFIG_BT_SETTINGS=y
CONFIG_FLASH=y
CONFIG_FLASH_PAGE_LAYOUT=y
CONFIG_FLASH_MAP=y

# Enable DK LED and Buttons library
CONFIG_DK_LIBRARY=y

CONFIG_SYSTEM_WORKQUEUE_STACK_SIZE=2048
# Config logger
CONFIG_LOG=y
CONFIG_USE_SEGGER_RTT=y

CONFIG_LOG_BACKEND_RTT=n
CONFIG_LOG_BACKEND_UART=y

CONFIG_LOG_PRINTK=y

CONFIG_ASSERT=y

CONFIG_UART_LINE_CTRL=n

# Nordic security layer + PSA
CONFIG_NRF_SECURITY=y
CONFIG_MBEDTLS_PSA_CRYPTO_C=y
CONFIG_PSA_CRYPTO_DRIVER_OBERON=y

# Tell PSA which features we want
CONFIG_PSA_WANT_KEY_TYPE_AES=y
CONFIG_PSA_WANT_ALG_GCM=y
# (If you later prefer CCM: set CONFIG_PSA_WANT_ALG_CCM=y and use PSA_ALG_CCM)
# (If you ever do CMAC:   set CONFIG_PSA_WANT_ALG_CMAC=y)
```

## src/main.c
```c
/*
 * Copyright (c) 2018 Nordic Semiconductor ASA
 *
 * SPDX-License-Identifier: LicenseRef-Nordic-5-Clause
 */

/** @file
 *  @brief Nordic UART Bridge Service (NUS) sample
 */

#include <zephyr/types.h>
#include <zephyr/kernel.h>
#include <zephyr/drivers/uart.h>
#include <zephyr/usb/usb_device.h>

#include <zephyr/device.h>
#include <zephyr/devicetree.h>
#include <soc.h>

#include <zephyr/bluetooth/bluetooth.h>
#include <zephyr/bluetooth/uuid.h>
#include <zephyr/bluetooth/gatt.h>
#include <zephyr/bluetooth/hci.h>

#include <zephyr/bluetooth/services/nus.h>

#include <dk_buttons_and_leds.h>

#include <zephyr/settings/settings.h>

#include <stdio.h>
#include <string.h>

#include <zephyr/logging/log.h>

#include "data.h"
#include "sensor_logic.h"

#define LOG_MODULE_NAME peripheral_uart
LOG_MODULE_REGISTER(LOG_MODULE_NAME);

/* Default Nordic UART Service (NUS) UUID in little-endian byte order */
#define BT_UUID_NUS_VAL \
    0x9e, 0xca, 0xdc, 0x24, 0x0e, 0xe5, 0xa9, 0xe0, \
    0x93, 0xf3, 0xa3, 0xb5, 0x01, 0x00, 0x40, 0x6e

/* Define a custom 16-bit UUID for the Nebula service identifier */
#define BT_UUID_NEBULA_VAL 0x180A
#define BT_UUID_NEBULA     BT_UUID_DECLARE_16(BT_UUID_NEBULA_VAL)

#define DEVICE_NAME CONFIG_BT_DEVICE_NAME
#define DEVICE_NAME_LEN	(sizeof(DEVICE_NAME) - 1)

#define RUN_STATUS_LED DK_LED1
#define RUN_LED_BLINK_INTERVAL 1000

#define CON_STATUS_LED DK_LED2

struct bt_conn *current_conn = NULL; // global, not static
static struct k_work adv_work;

// Advertise both the 128-bit NUS UUID and the 16-bit Nebula identifier UUID
static const struct bt_data ad[] = {
    BT_DATA_BYTES(BT_DATA_FLAGS, (BT_LE_AD_GENERAL | BT_LE_AD_NO_BREDR)),
    /* Advertise the 128-bit NUS Service UUID. No extra parentheses needed. */
    BT_DATA_BYTES(BT_DATA_UUID128_ALL, BT_UUID_NUS_VAL),
    /* Advertise the 16-bit custom Nebula UUID as an identifier */
    BT_DATA_BYTES(BT_DATA_UUID16_ALL, BT_UUID_16_ENCODE(BT_UUID_NEBULA_VAL)),
};

// Put the name in the scan response packet for debugging
static const struct bt_data sd[] = {
    BT_DATA(BT_DATA_NAME_COMPLETE, DEVICE_NAME, DEVICE_NAME_LEN),
};

static void advertising_start(void);

static void adv_work_handler(struct k_work *work)
{
    // Use the modern, non-deprecated advertising parameters
    struct bt_le_adv_param adv_param = {
        .id = BT_ID_DEFAULT,
        .sid = 0,
        .secondary_max_skip = 0,
        .options = BT_LE_ADV_OPT_CONNECTABLE,
        .interval_min = BT_GAP_ADV_FAST_INT_MIN_2,
        .interval_max = BT_GAP_ADV_FAST_INT_MAX_2,
        .peer = NULL,
    };

    int err = bt_le_adv_start(&adv_param, ad, ARRAY_SIZE(ad),
                  sd, ARRAY_SIZE(sd));
    if (err) {
        LOG_ERR("Advertising failed to start (err %d)", err);
    } else {
        LOG_INF("Advertising successfully started");
    }
}

// called when bluetooth device connects successfully to nrf
static void connected(struct bt_conn *conn, uint8_t err)
{
    char addr[BT_ADDR_LE_STR_LEN];

    if (err) {
        LOG_ERR("Connection failed, err 0x%02x %s", err, bt_hci_err_to_str(err));
        return;
    }

    bt_addr_le_to_str(
        bt_conn_get_dst(conn), // address of connecting device
        addr, sizeof(addr) 
    ); // convert binary address to readable string
    LOG_INF("Connected %s", addr); 

    current_conn = bt_conn_ref(conn);
    dk_set_led_on(CON_STATUS_LED);
}

// called when bluetooth device disconnects from nrf
static void disconnected(struct bt_conn *conn, uint8_t reason)
{
    char addr[BT_ADDR_LE_STR_LEN];

    bt_addr_le_to_str(bt_conn_get_dst(conn), addr, sizeof(addr));

    LOG_INF("Disconnected from %s (reason 0x%02x)", addr, reason);

    if (current_conn) {
        bt_conn_unref(current_conn);
        current_conn = NULL;
        // Immediately stop any ongoing data transfer.
        sensor_stop_transfer();
    }

    // Restart advertising
    k_work_submit(&adv_work);
}

/*
 * This callback is triggered when the stack is about to reuse a connection object.
 * It must be defined to satisfy the BT_CONN_CB_DEFINE macro's requirements.
 */
static void recycled_cb(void)
{
    /* Do nothing */
}

BT_CONN_CB_DEFINE(conn_callbacks) = {
    .connected        = connected,
    .disconnected     = disconnected,
    .recycled         = recycled_cb,
};

// ADD THIS FUNCTION DEFINITION
static void advertising_start(void)
{
    k_work_submit(&adv_work);
}

static void error(void)
{
    dk_set_leds_state(DK_ALL_LEDS_MSK, DK_NO_LEDS_MSK);

    while (true) {
        /* Spin for ever */
        k_sleep(K_MSEC(1000));
    }
}

static void configure_gpio(void)
{
    int err;

    err = dk_leds_init();
    if (err) {
        LOG_ERR("Cannot init LEDs (err: %d)", err);
    }
}

int main(void)
{
    int blink_status = 0;
    int err;

    configure_gpio(); // configure pins and LED
    sensor_init();

    err = bt_enable(NULL);
    if (err) {
        error();
    }

    LOG_INF("Bluetooth initialized");

    if (IS_ENABLED(CONFIG_SETTINGS)) {
        settings_load();
    }

    k_work_init(&adv_work, adv_work_handler);
    advertising_start();

    // send hello message every 5 seconds
    // k_work_init_delayable(&periodic_tx, periodic_tx_handler);
    // k_work_reschedule(&periodic_tx, K_SECONDS(5));		

	for (;;) {
		dk_set_led(RUN_STATUS_LED, (++blink_status) % 2);
		k_sleep(K_MSEC(RUN_LED_BLINK_INTERVAL));
	}
}
```

## src/aes-main-test.c
```c
#include <stdio.h>
#include "aes_gcm.h"

/*
int main(void)
{
    uint8_t key[NRF_CRYPTO_AES_KEY_SIZE] = {0x00, 0x01, 0x02, 0x03, 0x04, 0x05, 0x06, 0x07,
                                            0x08, 0x09, 0x0A, 0x0B, 0x0C, 0x0D, 0x0E, 0x0F};
    uint8_t iv[NRF_CRYPTO_AES_IV_SIZE] = {0xA0, 0xA1, 0xA2, 0xA3, 0xA4, 0xA5, 0xA6, 0xA7,
                                          0xA8, 0xA9, 0xAA, 0xAB};

    uint8_t plaintext[] = "I want to give up and drop FYP!";
    size_t length = sizeof(plaintext) - 1; // Subtract 1 to ignore the null-terminator
    size_t payload_length = NRF_CRYPTO_AES_IV_SIZE + length + NRF_CRYPTO_AES_IV_SIZE;
    uint8_t payload[payload_length];

    // Encrypt the character array
    //encrypt_character_array(key, iv, plaintext, payload, length);

    // Print the encrypted payload
    printf("Encrypted payload: ");
    for (size_t i = 0; i < payload_length; i++)
    {
        printf("%02x ", payload[i]);
    }
    printf("\n");

    return 0;
}
*/
```

## src/aes_gcm.c
```c
#include "aes_gcm.h"
#include <psa/crypto.h>        // PSA API
#include <string.h>
#include <stdio.h>

// payload layout: [IV | Ciphertext | Tag]
// key:  AES_GCM_KEY_SIZE bytes (16)
// iv:   AES_GCM_IV_SIZE  bytes (12)
// tag:  AES_GCM_TAG_SIZE bytes (16) appended by PSA to output

// replaced nrf_crypto_* modules
// nrf_crypto_* is legacy and not part of the Zephyr/NCS BLE app

void encrypt_character_array(const uint8_t *key, const uint8_t *iv, const uint8_t *plaintext, uint8_t *payload, size_t length)
{
    psa_status_t status;
    psa_key_id_t key_id = 0;
    psa_key_attributes_t attr = PSA_KEY_ATTRIBUTES_INIT;

    // make the ciphertext buffer
    // PSA produces CT||TAG; we’ll prepend IV ourselves
    uint8_t ct_and_tag[/* pt */ 0 + /* tag */ 0 + 1]; // placeholder to satisfy old compilers
    // Use variable length array for exact ciphertext + tag size:
    uint8_t ct_and_tag_vla[length + AES_GCM_TAG_SIZE];
    uint8_t *ct_and_tag_ptr = ct_and_tag_vla;

    size_t out_len = 0;

    // PSA init
    status = psa_crypto_init();
    if (status != PSA_SUCCESS) {
        printf("psa_crypto_init failed: %d\n", (int)status);
        return;
    }

    // Import a volatile AES-128 key (no persistent storage)
    psa_set_key_type(&attr, PSA_KEY_TYPE_AES);
    psa_set_key_bits(&attr, AES_GCM_KEY_SIZE * 8);
    psa_set_key_usage_flags(&attr, PSA_KEY_USAGE_ENCRYPT);
    psa_set_key_algorithm(&attr, PSA_ALG_GCM);

    status = psa_import_key(&attr, key, AES_GCM_KEY_SIZE, &key_id);
    if (status != PSA_SUCCESS) {
        printf("psa_import_key failed: %d\n", (int)status);
        return;
    }

    // AEAD encrypt (no AAD here; pass AAD ptr/len if you need associated data)
    status = psa_aead_encrypt(key_id, PSA_ALG_GCM,
                          iv, AES_GCM_IV_SIZE,   // nonce / IV (12 bytes recommended)
                          NULL, 0,               // AAD ptr/len (not added)
                          plaintext, length,     // input
                          ct_and_tag_ptr,         // ptr to ciphertext buffer
                          sizeof(ct_and_tag_vla), // size of ciphertext buffer
                          &out_len); // size of output in the buffer
    if (status != PSA_SUCCESS) {
        printf("psa_aead_encrypt failed: %d\n", (int)status);
        (void) psa_destroy_key(key_id);
        return;
    }

    // Expect ciphertext + tag
    if (out_len != (length + AES_GCM_TAG_SIZE)) {
        printf("psa_aead_encrypt unexpected out_len=%u\n", (unsigned)out_len);
        (void) psa_destroy_key(key_id);
        return;
    }

    // 3) Create the payload with the structure: IV || Ciphertext || Authentication Tag
    // Build payload = IV || CT || TAG
    memcpy(payload,                              iv,               AES_GCM_IV_SIZE); // iv
    memcpy(payload + AES_GCM_IV_SIZE,            ct_and_tag_ptr,   out_len);         // ciphertext and tag

    // free
    (void) psa_destroy_key(key_id);
}
```

## src/aes_gcm.h
```c
#ifndef AES_GCM_H
#define AES_GCM_H

#include <stdint.h>
#include <stddef.h>

/*
 * AES-GCM parameter constants
 * ---------------------------
 * AES-128 uses a 16-byte key (128 bits)
 * GCM standard IV length = 12 bytes (96 bits)
 * Authentication tag length = 16 bytes (128 bits)
 */

#define AES_GCM_KEY_SIZE   16   // 128-bit key
#define AES_GCM_IV_SIZE    12   // 96-bit nonce / IV
#define AES_GCM_TAG_SIZE   16   // 128-bit authentication tag

/*
 * Encrypts plaintext[] of 'length' bytes with AES-GCM.
 * Resulting payload layout:
 *    [IV | Ciphertext | Tag]
 *
 * 'payload' must have space for AES_GCM_IV_SIZE + length + AES_GCM_TAG_SIZE bytes.
 */
void encrypt_character_array(const uint8_t *key,
                             const uint8_t *iv,
                             const uint8_t *plaintext,
                             uint8_t *payload,
                             size_t length);

#endif /* AES_GCM_H */
```

## src/data.h
```c
#pragma once
#include <stdint.h>
#include <stddef.h>

#define CHUNK_SIZE 200u

// Same meaning as the old project
typedef struct __packed {
    uint8_t num_chunks;   // total chunks to send
    uint8_t chunks_rx;    // acks received from central
    uint8_t ready;        // 0=idle, 1=sending, 2=done
} meta_t;
```

## src/main_backup.c
```c
/*
 * Copyright (c) 2018 Nordic Semiconductor ASA
 *
 * SPDX-License-Identifier: LicenseRef-Nordic-5-Clause
 */

/** @file
 *  @brief Nordic UART Bridge Service (NUS) sample
 */
#include <uart_async_adapter.h>

#include <zephyr/types.h>
#include <zephyr/kernel.h>
#include <zephyr/drivers/uart.h>
#include <zephyr/usb/usb_device.h>

#include <zephyr/device.h>
#include <zephyr/devicetree.h>
#include <soc.h>

#include <zephyr/bluetooth/bluetooth.h>
#include <zephyr/bluetooth/uuid.h>
#include <zephyr/bluetooth/gatt.h>
#include <zephyr/bluetooth/hci.h>

#include <bluetooth/services/nus.h>

#include <dk_buttons_and_leds.h>

#include <zephyr/settings/settings.h>

#include <stdio.h>
#include <string.h>

#include <zephyr/logging/log.h>

#define LOG_MODULE_NAME peripheral_uart
LOG_MODULE_REGISTER(LOG_MODULE_NAME);

#define STACKSIZE CONFIG_BT_NUS_THREAD_STACK_SIZE
#define PRIORITY 7

#define DEVICE_NAME CONFIG_BT_DEVICE_NAME
#define DEVICE_NAME_LEN	(sizeof(DEVICE_NAME) - 1)

#define RUN_STATUS_LED DK_LED1
#define RUN_LED_BLINK_INTERVAL 1000

#define CON_STATUS_LED DK_LED2

#define KEY_PASSKEY_ACCEPT DK_BTN1_MSK
#define KEY_PASSKEY_REJECT DK_BTN2_MSK

#define UART_BUF_SIZE CONFIG_BT_NUS_UART_BUFFER_SIZE
#define UART_WAIT_FOR_BUF_DELAY K_MSEC(50)
#define UART_WAIT_FOR_RX CONFIG_BT_NUS_UART_RX_WAIT_TIME

static K_SEM_DEFINE(ble_init_ok, 0, 1);

static struct bt_conn *current_conn;
static struct bt_conn *auth_conn;
static struct k_work adv_work;

static const struct device *uart = DEVICE_DT_GET(DT_CHOSEN(nordic_nus_uart));
static struct k_work_delayable uart_work;

struct uart_data_t {
	void *fifo_reserved;
	uint8_t data[UART_BUF_SIZE];
	uint16_t len;
};

static K_FIFO_DEFINE(fifo_uart_tx_data);
static K_FIFO_DEFINE(fifo_uart_rx_data);

// advertisement packet?
static const struct bt_data ad[] = {
	BT_DATA_BYTES(BT_DATA_FLAGS, (BT_LE_AD_GENERAL | BT_LE_AD_NO_BREDR)),
	// device discoverable in general discovery mode | ble-only device
	BT_DATA(BT_DATA_NAME_COMPLETE, DEVICE_NAME, DEVICE_NAME_LEN), // device name
};

// scan response data (upon receiving scan requests, respond with this data)
static const struct bt_data sd[] = {
	BT_DATA_BYTES(BT_DATA_UUID128_ALL, BT_UUID_NUS_VAL),
	// nordic UART service (NUS) UUID, telling other devices this device has UART-over-bluetooth funct
};

#ifdef CONFIG_UART_ASYNC_ADAPTER
UART_ASYNC_ADAPTER_INST_DEFINE(async_adapter);
#else
#define async_adapter NULL
#endif

// cb - callback
// whenever something happens in UART, call this func (general func)
// UART -> bluetooth, data is queued to be sent over BLE
// bluetooth -> UART, when receive BLE, sent out via UART to PC
static void uart_cb(const struct device *dev, struct uart_event *evt, void *user_data)
{
	ARG_UNUSED(dev);

	static size_t aborted_len;
	struct uart_data_t *buf;
	static uint8_t *aborted_buf;
	static bool disable_req;

	switch (evt->type) {
	case UART_TX_DONE: // transmission done
		LOG_DBG("UART_TX_DONE");
		if ((evt->data.tx.len == 0) ||
		    (!evt->data.tx.buf)) {
			return;
		}

		if (aborted_buf) {
			buf = CONTAINER_OF(aborted_buf, struct uart_data_t,
					   data[0]);
			aborted_buf = NULL;
			aborted_len = 0;
		} else {
			buf = CONTAINER_OF(evt->data.tx.buf, struct uart_data_t,
					   data[0]);
		}

		k_free(buf);

		buf = k_fifo_get(&fifo_uart_tx_data, K_NO_WAIT);
		if (!buf) {
			return;
		}

		if (uart_tx(uart, buf->data, buf->len, SYS_FOREVER_MS)) {
			LOG_WRN("Failed to send data over UART");
		}

		break;

	case UART_RX_RDY: // data received
		LOG_DBG("UART_RX_RDY");
		buf = CONTAINER_OF(evt->data.rx.buf, struct uart_data_t, data[0]);
		buf->len += evt->data.rx.len;

		if (disable_req) {
			return;
		}

		if ((evt->data.rx.buf[buf->len - 1] == '\n') ||
		    (evt->data.rx.buf[buf->len - 1] == '\r')) {
			disable_req = true;
			uart_rx_disable(uart);
		}

		break;

	case UART_RX_DISABLED: // reception stopped
		LOG_DBG("UART_RX_DISABLED");
		disable_req = false;

		buf = k_malloc(sizeof(*buf));
		if (buf) {
			buf->len = 0;
		} else {
			LOG_WRN("Not able to allocate UART receive buffer");
			k_work_reschedule(&uart_work, UART_WAIT_FOR_BUF_DELAY);
			return;
		}

		uart_rx_enable(uart, buf->data, sizeof(buf->data),
			       UART_WAIT_FOR_RX);

		break;

	case UART_RX_BUF_REQUEST: // need more buffer space
		LOG_DBG("UART_RX_BUF_REQUEST");
		buf = k_malloc(sizeof(*buf));
		if (buf) {
			buf->len = 0;
			uart_rx_buf_rsp(uart, buf->data, sizeof(buf->data));
		} else {
			LOG_WRN("Not able to allocate UART receive buffer");
		}

		break;

	case UART_RX_BUF_RELEASED: // buffer no longer needed
		LOG_DBG("UART_RX_BUF_RELEASED");
		buf = CONTAINER_OF(evt->data.rx_buf.buf, struct uart_data_t,
				   data[0]);

		if (buf->len > 0) {
			k_fifo_put(&fifo_uart_rx_data, buf);
		} else {
			k_free(buf);
		}

		break;

	case UART_TX_ABORTED: // transmission interrupted
		LOG_DBG("UART_TX_ABORTED");
		if (!aborted_buf) {
			aborted_buf = (uint8_t *)evt->data.tx.buf;
		}

		aborted_len += evt->data.tx.len;
		buf = CONTAINER_OF((void *)aborted_buf, struct uart_data_t,
				   data);

		uart_tx(uart, &buf->data[aborted_len],
			buf->len - aborted_len, SYS_FOREVER_MS);

		break;

	default:
		break;
	}
}

// set up UART (default codes)
static void uart_work_handler(struct k_work *item)
{
	struct uart_data_t *buf;

	buf = k_malloc(sizeof(*buf));
	if (buf) {
		buf->len = 0;
	} else {
		LOG_WRN("Not able to allocate UART receive buffer");
		k_work_reschedule(&uart_work, UART_WAIT_FOR_BUF_DELAY);
		return;
	}

	uart_rx_enable(uart, buf->data, sizeof(buf->data), UART_WAIT_FOR_RX);
}

static bool uart_test_async_api(const struct device *dev)
{
	const struct uart_driver_api *api =
			(const struct uart_driver_api *)dev->api;

	return (api->callback_set != NULL);
}

// initialises UART (wire comms to nrf), displays "Starting nordic UART service"
static int uart_init(void)
{
	int err;
	int pos;
	struct uart_data_t *rx;
	struct uart_data_t *tx;

	if (!device_is_ready(uart)) {
		return -ENODEV;
	}

	if (IS_ENABLED(CONFIG_USB_DEVICE_STACK)) {
		err = usb_enable(NULL);
		if (err && (err != -EALREADY)) {
			LOG_ERR("Failed to enable USB");
			return err;
		}
	}

	rx = k_malloc(sizeof(*rx));
	if (rx) {
		rx->len = 0;
	} else {
		return -ENOMEM;
	}

	k_work_init_delayable(&uart_work, uart_work_handler);


	if (IS_ENABLED(CONFIG_UART_ASYNC_ADAPTER) && !uart_test_async_api(uart)) {
		/* Implement API adapter */
		uart_async_adapter_init(async_adapter, uart);
		uart = async_adapter;
	}

	err = uart_callback_set(uart, uart_cb, NULL);
	if (err) {
		k_free(rx);
		LOG_ERR("Cannot initialize UART callback");
		return err;
	}

	if (IS_ENABLED(CONFIG_UART_LINE_CTRL)) {
		LOG_INF("Wait for DTR");
		while (true) {
			uint32_t dtr = 0;

			uart_line_ctrl_get(uart, UART_LINE_CTRL_DTR, &dtr);
			if (dtr) {
				break;
			}
			/* Give CPU resources to low priority threads. */
			k_sleep(K_MSEC(100));
		}
		LOG_INF("DTR set");
		err = uart_line_ctrl_set(uart, UART_LINE_CTRL_DCD, 1);
		if (err) {
			LOG_WRN("Failed to set DCD, ret code %d", err);
		}
		err = uart_line_ctrl_set(uart, UART_LINE_CTRL_DSR, 1);
		if (err) {
			LOG_WRN("Failed to set DSR, ret code %d", err);
		}
	}

	tx = k_malloc(sizeof(*tx));

	if (tx) {
		// first thing that shows on output
		pos = snprintf(tx->data, sizeof(tx->data),
			       "Starting Nordic UART service sample\r\n");

		if ((pos < 0) || (pos >= sizeof(tx->data))) {
			k_free(rx);
			k_free(tx);
			LOG_ERR("snprintf returned %d", pos);
			return -ENOMEM;
		}

		tx->len = pos;
	} else {
		k_free(rx);
		return -ENOMEM;
	}

	err = uart_tx(uart, tx->data, tx->len, SYS_FOREVER_MS);
	if (err) {
		k_free(rx);
		k_free(tx);
		LOG_ERR("Cannot display welcome message (err: %d)", err);
		return err;
	}

	err = uart_rx_enable(uart, rx->data, sizeof(rx->data), UART_WAIT_FOR_RX);
	if (err) {
		LOG_ERR("Cannot enable uart reception (err: %d)", err);
		/* Free the rx buffer only because the tx buffer will be handled in the callback */
		k_free(rx);
	}

	return err;
}

// BLE advertising, 
static void adv_work_handler(struct k_work *work)
{
	// if success, devices -> discoverable and appears in bluetooth scans on phones/comp
	int err = bt_le_adv_start(BT_LE_ADV_CONN_FAST_2, // connectable fast advert 2x speed
		ad, ARRAY_SIZE(ad), // device name, flags
		sd, ARRAY_SIZE(sd)); // scan response data, nordic UART service UUID

	if (err) {
		LOG_ERR("Advertising failed to start (err %d)", err);
		return;
	}

	LOG_INF("Advertising successfully started");
}

// wrapper func, schedules advert work to run asynchronously using work queue system
// for thread safety, error handling
// called during startup in main()
// after disconnect in recycled_cb()
// adv_work_handler() called automatically by work queue system
static void advertising_start(void)
{
	k_work_submit(&adv_work);
}

// helper func to send messages
static void send_hello(void)
{
    static const char msg[] = "hello from pc!\r\n";

    if (!current_conn) {
        LOG_WRN("No BLE connection yet!");
        return;
    }

    int err = bt_nus_send(current_conn, msg, strlen(msg));  // send to current central
    if (err) {
        LOG_WRN("bt_nus_send failed (%d)", err);
    } else {
        LOG_INF("Sent: %s", msg);
    }
}

// called when bluetooth device connects successfully to nrf
static void connected(struct bt_conn *conn, uint8_t err)
{
	char addr[BT_ADDR_LE_STR_LEN];

	if (err) {
		LOG_ERR("Connection failed, err 0x%02x %s", err, bt_hci_err_to_str(err));
		return;
	}

	bt_addr_le_to_str(
		bt_conn_get_dst(conn), // address of connecting device
		addr, sizeof(addr) 
	); // convert binary address to readable string
	LOG_INF("Connected %s", addr); 

	current_conn = bt_conn_ref(conn); // current_conn global var, increments

	dk_set_led_on(CON_STATUS_LED); // LED2 turns on

	// send hello once after connected
	send_hello();
}

// called when bluetooth device disconnects from nrf
static void disconnected(struct bt_conn *conn, uint8_t reason)
{
	char addr[BT_ADDR_LE_STR_LEN];

	bt_addr_le_to_str(bt_conn_get_dst(conn), addr, sizeof(addr));
	// show address and reason
	LOG_INF("Disconnected: %s, reason 0x%02x %s", addr, reason, bt_hci_err_to_str(reason));

	if (auth_conn) {
		bt_conn_unref(auth_conn); 
		auth_conn = NULL;
	}

	if (current_conn) {
		bt_conn_unref(current_conn); // decrements global var
		current_conn = NULL;
		dk_set_led_off(CON_STATUS_LED); // turn off LED2
	}
}

// happens on disconnect
static void recycled_cb(void)
{
	LOG_INF("Connection object available from previous conn. Disconnect is complete!");
	advertising_start();
}

#ifdef CONFIG_BT_NUS_SECURITY_ENABLED
static void security_changed(struct bt_conn *conn, bt_security_t level,
			     enum bt_security_err err)
{
	char addr[BT_ADDR_LE_STR_LEN];

	bt_addr_le_to_str(bt_conn_get_dst(conn), addr, sizeof(addr));

	if (!err) {
		LOG_INF("Security changed: %s level %u", addr, level);
	} else {
		LOG_WRN("Security failed: %s level %u err %d %s", addr, level, err,
			bt_security_err_to_str(err));
	}
}
#endif

BT_CONN_CB_DEFINE(conn_callbacks) = {
	.connected        = connected,
	.disconnected     = disconnected,
	.recycled         = recycled_cb,
#ifdef CONFIG_BT_NUS_SECURITY_ENABLED
	.security_changed = security_changed,
#endif
};

#if defined(CONFIG_BT_NUS_SECURITY_ENABLED)
static void auth_passkey_display(struct bt_conn *conn, unsigned int passkey)
{
	char addr[BT_ADDR_LE_STR_LEN];

	bt_addr_le_to_str(bt_conn_get_dst(conn), addr, sizeof(addr));

	LOG_INF("Passkey for %s: %06u", addr, passkey);
}

static void auth_passkey_confirm(struct bt_conn *conn, unsigned int passkey)
{
	char addr[BT_ADDR_LE_STR_LEN];

	auth_conn = bt_conn_ref(conn);

	bt_addr_le_to_str(bt_conn_get_dst(conn), addr, sizeof(addr));

	LOG_INF("Passkey for %s: %06u", addr, passkey);

	if (IS_ENABLED(CONFIG_SOC_SERIES_NRF54HX) || IS_ENABLED(CONFIG_SOC_SERIES_NRF54LX)) {
		LOG_INF("Press Button 0 to confirm, Button 1 to reject.");
	} else {
		LOG_INF("Press Button 1 to confirm, Button 2 to reject.");
	}
}


static void auth_cancel(struct bt_conn *conn)
{
	char addr[BT_ADDR_LE_STR_LEN];

	bt_addr_le_to_str(bt_conn_get_dst(conn), addr, sizeof(addr));

	LOG_INF("Pairing cancelled: %s", addr);
}


static void pairing_complete(struct bt_conn *conn, bool bonded)
{
	char addr[BT_ADDR_LE_STR_LEN];

	bt_addr_le_to_str(bt_conn_get_dst(conn), addr, sizeof(addr));

	LOG_INF("Pairing completed: %s, bonded: %d", addr, bonded);
}


static void pairing_failed(struct bt_conn *conn, enum bt_security_err reason)
{
	char addr[BT_ADDR_LE_STR_LEN];

	bt_addr_le_to_str(bt_conn_get_dst(conn), addr, sizeof(addr));

	LOG_INF("Pairing failed conn: %s, reason %d %s", addr, reason,
		bt_security_err_to_str(reason));
}

static struct bt_conn_auth_cb conn_auth_callbacks = {
	.passkey_display = auth_passkey_display,
	.passkey_confirm = auth_passkey_confirm,
	.cancel = auth_cancel,
};

static struct bt_conn_auth_info_cb conn_auth_info_callbacks = {
	.pairing_complete = pairing_complete,
	.pairing_failed = pairing_failed
};
#else
static struct bt_conn_auth_cb conn_auth_callbacks;
static struct bt_conn_auth_info_cb conn_auth_info_callbacks;
#endif

static void bt_receive_cb(struct bt_conn *conn, const uint8_t *const data,
			  uint16_t len)
{
	int err;
	char addr[BT_ADDR_LE_STR_LEN] = {0};

	bt_addr_le_to_str(bt_conn_get_dst(conn), addr, ARRAY_SIZE(addr));

	LOG_INF("Received data from: %s", addr);

	// for text data, add this:
    char text_buf[len + 1];
    memcpy(text_buf, data, len);
    text_buf[len] = '\0';  // null terminate
    LOG_INF("Data received as text: '%s'", text_buf);

	for (uint16_t pos = 0; pos != len;) {
		struct uart_data_t *tx = k_malloc(sizeof(*tx));

		if (!tx) {
			LOG_WRN("Not able to allocate UART send data buffer");
			return;
		}

		/* Keep the last byte of TX buffer for potential LF char. */
		size_t tx_data_size = sizeof(tx->data) - 1;

		if ((len - pos) > tx_data_size) {
			tx->len = tx_data_size;
		} else {
			tx->len = (len - pos);
		}

		memcpy(tx->data, &data[pos], tx->len);

		pos += tx->len;

		/* Append the LF character when the CR character triggered
		 * transmission from the peer.
		 */
		if ((pos == len) && (data[len - 1] == '\r')) {
			tx->data[tx->len] = '\n';
			tx->len++;
		}

		err = uart_tx(uart, tx->data, tx->len, SYS_FOREVER_MS);
		if (err) {
			k_fifo_put(&fifo_uart_tx_data, tx);
		}
	}
}

// forwards data from BLE to UART (NRF to PC)
static struct bt_nus_cb nus_cb = {
	.received = bt_receive_cb,
};

void error(void)
{
	dk_set_leds_state(DK_ALL_LEDS_MSK, DK_NO_LEDS_MSK);

	while (true) {
		/* Spin for ever */
		k_sleep(K_MSEC(1000));
	}
}

#ifdef CONFIG_BT_NUS_SECURITY_ENABLED
static void num_comp_reply(bool accept)
{
	if (accept) {
		bt_conn_auth_passkey_confirm(auth_conn);
		LOG_INF("Numeric Match, conn %p", (void *)auth_conn);
	} else {
		bt_conn_auth_cancel(auth_conn);
		LOG_INF("Numeric Reject, conn %p", (void *)auth_conn);
	}

	bt_conn_unref(auth_conn);
	auth_conn = NULL;
}

void button_changed(uint32_t button_state, uint32_t has_changed)
{
	uint32_t buttons = button_state & has_changed;

	if (auth_conn) {
		if (buttons & KEY_PASSKEY_ACCEPT) {
			num_comp_reply(true);
		}

		if (buttons & KEY_PASSKEY_REJECT) {
			num_comp_reply(false);
		}
	}
}
#endif /* CONFIG_BT_NUS_SECURITY_ENABLED */

static void configure_gpio(void)
{
	int err;

#ifdef CONFIG_BT_NUS_SECURITY_ENABLED
	err = dk_buttons_init(button_changed);
	if (err) {
		LOG_ERR("Cannot init buttons (err: %d)", err);
	}
#endif /* CONFIG_BT_NUS_SECURITY_ENABLED */

	err = dk_leds_init();
	if (err) {
		LOG_ERR("Cannot init LEDs (err: %d)", err);
	}
}


// // to send the hello message to connected devices every 5 seconds
// static struct k_work_delayable periodic_tx;

// static void periodic_tx_handler(struct k_work *work)
// {
//     send_hello();
//     k_work_reschedule(&periodic_tx, K_SECONDS(5));  // send every 5s
// }

int main(void)
{
	int blink_status = 0;
	int err = 0;

	configure_gpio(); // configure pins and LED

	err = uart_init();
	if (err) {
		error();
	}

	if (IS_ENABLED(CONFIG_BT_NUS_SECURITY_ENABLED)) {
		err = bt_conn_auth_cb_register(&conn_auth_callbacks);
		if (err) {
			LOG_ERR("Failed to register authorization callbacks. (err: %d)", err);
			return 0;
		}

		err = bt_conn_auth_info_cb_register(&conn_auth_info_callbacks);
		if (err) {
			LOG_ERR("Failed to register authorization info callbacks. (err: %d)", err);
			return 0;
		}
	}

	err = bt_enable(NULL);
	if (err) {
		error();
	}

	LOG_INF("Bluetooth initialized");

	k_sem_give(&ble_init_ok);

	if (IS_ENABLED(CONFIG_SETTINGS)) {
		settings_load();
	}

	err = bt_nus_init(&nus_cb);
	if (err) {
		LOG_ERR("Failed to initialize UART service (err: %d)", err);
		return 0;
	}

	k_work_init(&adv_work, adv_work_handler);
	advertising_start();

	// send hello message every 5 seconds
	// k_work_init_delayable(&periodic_tx, periodic_tx_handler);
	// k_work_reschedule(&periodic_tx, K_SECONDS(5));		

	for (;;) {
		dk_set_led(RUN_STATUS_LED, (++blink_status) % 2);
		k_sleep(K_MSEC(RUN_LED_BLINK_INTERVAL));
	}
}

/* only needed if reading UART input
void ble_write_thread(void)
{
	// Don't go any further until BLE is initialized
	k_sem_take(&ble_init_ok, K_FOREVER);
	struct uart_data_t nus_data = {
		.len = 0,
	};

	for (;;) {
		// Wait indefinitely for data to be sent over bluetooth 
		// ble_write_thread continuously monitors fifo_uart_rx_data queue for incoming data (from PC)

		struct uart_data_t *buf = k_fifo_get(&fifo_uart_rx_data,
						     K_FOREVER);

		int plen = MIN(sizeof(nus_data.data) - nus_data.len, buf->len);
		int loc = 0;

		while (plen > 0) {
			memcpy(&nus_data.data[nus_data.len], &buf->data[loc], plen);
			nus_data.len += plen;
			loc += plen;

			// waits for bytes to arrive, buffers until newline or full buffer
			if (nus_data.len >= sizeof(nus_data.data) ||
			   (nus_data.data[nus_data.len - 1] == '\n') ||
			   (nus_data.data[nus_data.len - 1] == '\r')) {

				// bt_nus_send(NULL = send to all connected peers,
				// 		data, len(data)
				// )
				if (bt_nus_send(NULL, nus_data.data, nus_data.len)) {
					LOG_WRN("Failed to send data over BLE connection");
				}
				nus_data.len = 0;
			}

			plen = MIN(sizeof(nus_data.data), buf->len - loc);
		}

		k_free(buf);
	}
}
*/

/*
// used for detecting UART input (from pc)
// this calls ble_write_thread(void) right on top
K_THREAD_DEFINE(ble_write_thread_id, STACKSIZE, ble_write_thread, NULL, NULL,
		NULL, PRIORITY, 0, 0);
*/
```

## src/sensor_logic.c
```c
/*
 * Move kernel.h to the top. This transitively includes autoconf.h,
 * which is required for the NUS service functions to be declared correctly.
 */
#include <zephyr/kernel.h>
#include <string.h>
#include <zephyr/logging/log.h>
#include <zephyr/random/random.h>      // sys_csrand_get()
#include <zephyr/bluetooth/bluetooth.h>
#include <zephyr/bluetooth/services/nus.h> // Include NUS header

#include "data.h"
#include "aes_gcm.h"
#include "sensor_logic.h"

// This is defined in main.c, declare it here to use it
extern struct bt_conn *current_conn;

LOG_MODULE_DECLARE(peripheral_uart, LOG_LEVEL_INF);

// ---- App state (replace sizes with your real max payload) ----
static struct {
    // Plaintext to protect (fill this with your real sensor bytes)
    uint8_t  plaintext[2048];
    size_t   plaintext_len;

    // Encrypted payload = IV || CT || TAG
    uint8_t  payload[2048 + AES_GCM_IV_SIZE + AES_GCM_TAG_SIZE];
    size_t   payload_len;

    // Transfer progress
    size_t   off;
    bool     running;

    // Metadata (like the old code)
    meta_t   meta;

    // Crypto IV (12 bytes)
    uint8_t  iv[AES_GCM_IV_SIZE];

    struct k_work_delayable tx_work;
} S;

// ---- Work handler to push chunks over NUS ----
static void tx_work_handler(struct k_work *work)
{
    if (!S.running || !current_conn) {
        return;
    }

    if (S.off >= S.payload_len) {
        S.meta.ready = 2; // done
        S.running = false;
        LOG_INF("transfer complete (%u bytes)", (unsigned)S.payload_len);
        return;
    }

    // Dynamically calculate the chunk size based on the connection's actual MTU.
    // This is the correct and robust way to handle data transmission.
    // queries the actual, negotiated MTU for current_conn which will be sent by ESP32
    uint16_t mtu = bt_gatt_get_mtu(current_conn);
    size_t chunk_len = MIN(S.payload_len - S.off, mtu - 3);

    int err = bt_nus_send(current_conn, &S.payload[S.off], chunk_len);
    if (err) {
        // If the error is ENOMEM (-12), it's a temporary buffer issue, so we can retry.
        // Any other error (like -ENOTCONN) is fatal for this transfer.
        if (err == -ENOMEM) {
            LOG_WRN("bt_nus_send err %d (retry)", err);
            k_work_reschedule(&S.tx_work, K_MSEC(5));
        } else {
            LOG_ERR("bt_nus_send fatal error %d, stopping transfer.", err);
            // Stop the transfer immediately on a fatal error.
            S.running = false;
        }
        return;
    }

    S.off += chunk_len;

    // Schedule the next chunk of data to be sent.
    // A small delay here allows the CPU to sleep, saving power, since this handler uses busy waiting. 
    // This also reduces the chance of hitting the "No ATT channel" race condition.
    // K_MSEC(5) = 5 ms delay
    k_work_reschedule(&S.tx_work, K_MSEC(5));
    // INTENTIONAL DELAY HERE. REDUCE if higher throughput needed.
}

// This new function will be called from main.c on disconnect.
// handle race condition TX loops before disconnected callback, No ATT channel Error
void sensor_stop_transfer(void)
{
    if (S.running) {
        S.running = false;
        // Cancel any pending work to ensure no more send attempts are made.
        k_work_cancel_delayable(&S.tx_work);
        LOG_INF("Transfer stopped due to disconnect.");
    }
}

// Define the callbacks for the NUS service
static struct bt_nus_cb nus_callbacks = {
    .received = sensor_on_rx_cmd,
};

void sensor_init(void)
{
    int err;

    memset(&S, 0, sizeof(S));
    k_work_init_delayable(&S.tx_work, tx_work_handler);

    // replaces bt_nus_init()
    err = bt_nus_cb_register(&nus_callbacks, NULL);
    if (err) {
        LOG_ERR("Failed to initialize NUS service (err: %d)", err);
    }
}

// Fill S.plaintext with your real data
static void fill_plaintext_demo(void)
{
    static const char demo[] = "NEBULA demo payload — replace with real sensor data";
    memcpy(S.plaintext, demo, sizeof(demo));
    S.plaintext_len = sizeof(demo);
}

void sensor_prepare_payload(void)
{
    // 1) Fill plaintext
    fill_plaintext_demo();

    /* Comment out all encryption codes, send in plaintext
    
    // 2) Random IV (12 bytes). On Nordic DKs, sys_csrand_get() draws from HW entropy.
    sys_csrand_get(S.iv, sizeof(S.iv));

    // 3) Encrypt: output layout = IV || CT || TAG (your PSA-backed function)
    encrypt_character_array(
        //key (const uint8_t*)"\x00\x01\x02\x03\x04\x05\x06\x07\x08\x09\x0A\x0B\x0C\x0D\x0E\x0F",
        //iv   S.iv,
        //pt   S.plaintext,
        //out  S.payload,
        //len  S.plaintext_len
    );
    S.payload_len = AES_GCM_IV_SIZE + S.plaintext_len + AES_GCM_TAG_SIZE;
    */

    // Send plaintext directly without encryption
    memcpy(S.payload, S.plaintext, S.plaintext_len);
    S.payload_len = S.plaintext_len;

    // 4) Init metadata like the old code
    S.meta.num_chunks = (S.payload_len + CHUNK_SIZE - 1) / CHUNK_SIZE;
    S.meta.chunks_rx  = 0;
    S.meta.ready      = 1;   // “sending”
    S.off             = 0;

    // logs to show plaintext being sent
    LOG_INF("Payload to be sent: \"%.*s\"", (int)S.payload_len, S.payload);
}

void sensor_start_transfer(void)
{
    if (!current_conn) {
        LOG_WRN("no connection; cannot start transfer");
        return;
    }
    if (S.payload_len == 0) {
        sensor_prepare_payload();
    }
    S.running = true;
    k_work_reschedule(&S.tx_work, K_NO_WAIT);
}

// Very small command parser over NUS RX.
// You can keep the old 3-byte metadata flow by having the central send “ACK”
// after each chunk, or keep it simple: central sends “START”, we stream.
void sensor_on_rx_cmd(struct bt_conn *conn, const uint8_t *data, uint16_t len)
{
    // The 'conn' parameter is unused in this case, but required by the signature.
    // The (void)conn; cast prevents a compiler warning about an unused variable.
    (void)conn;

    if (len >= 5 && !memcmp(data, "START", 5)) {
        LOG_INF("START received from central");
        sensor_prepare_payload();
        LOG_INF("payload prepared starting transfer");
        sensor_start_transfer();
        return;
    }

    if (len >= 4 && !memcmp(data, "PREP", 4)) {
        LOG_INF("PREP received from central");
        sensor_prepare_payload();
        return;
    }

    // Optional: accept acknowledgments like the old metadata flow
    // Example: "ACK <n>" increments S.meta.chunks_rx to <n>
    if (len >= 3 && !memcmp(data, "ACK", 3)) {
        // parse number after ACK if you want strict syncing
        LOG_INF("ACK received from central");
        return;
    }

    LOG_INF("RX cmd ignored (len=%u)", (unsigned)len);
}
```

## src/sensor_logic.h
```c
#ifndef SENSOR_LOGIC_H
#define SENSOR_LOGIC_H

#include <stddef.h>
#include <stdint.h>
#include <zephyr/bluetooth/conn.h>

void sensor_init(void);
void sensor_prepare_payload(void);
void sensor_start_transfer(void);
void sensor_stop_transfer(void);
void sensor_on_rx_cmd(struct bt_conn *conn, const uint8_t *data, uint16_t len);

#endif // SENSOR_LOGIC_H
```
